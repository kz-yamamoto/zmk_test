/* boards/shields/helix/helix_right.overlay */

&kscan {
    compatible = "zmk,keyboard-matrix";
    #binding-cells = <2>;
    row-gpios = <
        &gpio0 5 GPIO_ACTIVE_HIGH
        &gpio0 6 GPIO_ACTIVE_HIGH
        &gpio0 7 GPIO_ACTIVE_HIGH
        &gpio0 8 GPIO_ACTIVE_HIGH
        &gpio0 9 GPIO_ACTIVE_HIGH
    >;
    col-gpios = <
        &gpio1 6 GPIO_ACTIVE_HIGH
        &gpio1 7 GPIO_ACTIVE_HIGH
        &gpio1 8 GPIO_ACTIVE_HIGH
        &gpio1 9 GPIO_ACTIVE_HIGH
        &gpio1 10 GPIO_ACTIVE_HIGH
        &gpio1 11 GPIO_ACTIVE_HIGH
    >;
};

&led1 {
    label = "led1";
    gpios = <&gpio2 1 GPIO_ACTIVE_HIGH>;
};
