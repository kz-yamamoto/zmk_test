/* boards/shields/helix/helix_left.overlay */

&kscan {
    compatible = "zmk,keyboard-matrix";
    #binding-cells = <2>;
    row-gpios = <
        &gpio0 0 GPIO_ACTIVE_HIGH
        &gpio0 1 GPIO_ACTIVE_HIGH
        &gpio0 2 GPIO_ACTIVE_HIGH
        &gpio0 3 GPIO_ACTIVE_HIGH
        &gpio0 4 GPIO_ACTIVE_HIGH
    >;
    col-gpios = <
        &gpio1 0 GPIO_ACTIVE_HIGH
        &gpio1 1 GPIO_ACTIVE_HIGH
        &gpio1 2 GPIO_ACTIVE_HIGH
        &gpio1 3 GPIO_ACTIVE_HIGH
        &gpio1 4 GPIO_ACTIVE_HIGH
        &gpio1 5 GPIO_ACTIVE_HIGH
    >;
};

&led0 {
    label = "led0";
    gpios = <&gpio2 0 GPIO_ACTIVE_HIGH>;
};
